## idf/esp-node/sdkconfig.defaults
```kconfig
# Override some defaults so BT stack is enabled
# in this example

#
# BT config
#
CONFIG_BT_ENABLED=y
CONFIG_BTDM_CTRL_MODE_BLE_ONLY=y
CONFIG_BTDM_CTRL_MODE_BR_EDR_ONLY=n
CONFIG_BTDM_CTRL_MODE_BTDM=n
CONFIG_BT_BLUEDROID_ENABLED=n
CONFIG_BT_NIMBLE_ENABLED=y

# Enable support for power management
CONFIG_PM_ENABLE=y
# Enable tickless idle mode
CONFIG_FREERTOS_USE_TICKLESS_IDLE=y
# Set the tick rate at which FreeRTOS does pre-emptive context switching.
CONFIG_FREERTOS_HZ=100
# Minimum number of ticks to enter sleep mode for
CONFIG_FREERTOS_IDLE_TIME_BEFORE_SLEEP=3
CONFIG_FREERTOS_TIMER_TASK_STACK_DEPTH=4000

# Flash size reduction
CONFIG_COMPILER_OPTIMIZATION_SIZE=y
CONFIG_BT_NIMBLE_LOG_LEVEL=0
CONFIG_LOG_DEFAULT_LEVEL=0
CONFIG_BT_NIMBLE_MAX_CONNECTIONS=1
CONFIG_BT_NIMBLE_ROLE_CENTRAL=n
CONFIG_BT_NIMBLE_ROLE_OBSERVER=n
CONFIG_BT_NIMBLE_ROLE_BROADCASTER=n
CONFIG_BT_NIMBLE_ENABLE_CONN_REATTEMPT=n

CONFIG_ESP_WIFI_ENABLED=n
```

## idf/esp-node/sdkconfig.defaults.esp32
```kconfig
CONFIG_IDF_TARGET="esp32"

# MODEM SLEEP Options
CONFIG_BTDM_CTRL_MODEM_SLEEP=y
CONFIG_BTDM_CTRL_MODEM_SLEEP_MODE_ORIG=y
# Bluetooth low power clock
# CONFIG_BTDM_CTRL_LPCLK_SEL_EXT_32K_XTAL is not set
CONFIG_BTDM_CTRL_LPCLK_SEL_MAIN_XTAL=y

# RTC clock source
CONFIG_RTC_CLK_SRC_INT_RC=y
# CONFIG_RTC_CLK_SRC_EXT_CRYS is not set

# Run FreeRTOS only on first core
CONFIG_FREERTOS_UNICORE=y
```
